## boards/shields/lily58_left/Kconfig.defconfig
```kconfig
if SHIELD_LILY58_LEFT
config ZMK_KEYBOARD_NAME
    default "Lily58 L"
config ZMK_SPLIT
    default y
config ZMK_SPLIT_ROLE_CENTRAL
    default y
config ZMK_BLE
    default y
endif
```

## boards/shields/lily58_right/Kconfig.defconfig
```kconfig
if SHIELD_LILY58_RIGHT
config ZMK_SPLIT
    default y
config ZMK_BLE
    default y
endif
```
